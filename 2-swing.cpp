// This was generated by Best_codes for Arduino Cat by Osoyoo
// Codes benefit others

#include "IRremoteExt.h"

#include <Arduino.h>
#include <Wire.h>
#include <SoftwareSerial.h>
#include <Servo.h>

float running = 0;
float angle = 0;
float dir = 0;

int getKey(){
   handleIRremote();
    unsigned long value = getPressedIRremote();
    if( value != 0xffffffff){

     //Serial.println(value,HEX);
      if (value==0xff38c7) return 'O';
      else if (value==0xff6897) return '*';
      else if (value==0xffb04f) return '#';
      else if (value==0xff18e7) return 'U';
      else if (value==0xff4ab5) return 'D';
      else if (value==0xff10ef) return 'L';
      else if (value==0xff5aa5) return 'R';
      else if (value==0xffa25d) return 1;
      else if (value==0xff629D) return 2;
      else if (value==0xffe21d) return 3;
      else if (value==0xff22dd) return 4;
      else if (value==0xff02fd) return 5;
      else if (value==0xffc23d) return 6;
      else if (value==0xffe01f) return 7;
      else if (value==0xffa857) return 8;
      else if (value==0xff906f) return 9;
      else if (value==0xff9867) return 0;
    }
    return -1;

}
Servo servo_2;

void _delay(float seconds) {
  long endTime = millis() + seconds * 1000;
  while(millis() < endTime) _loop();
}

void setup() {
  beginIRremote(7);
  servo_2.attach(2);
  running = 0;
  angle = 90;
  dir = 2;
  while(1) {
      if(getKey() == 1.000000){
        angle = 0;

      }
      if(getKey() == 2.000000){
        angle = 90;

      }
      if(getKey() == 3.000000){
        angle = 180;

      }
      if(getKey() == 79.000000){
        running = ((1 - running));

      }
      if(running == 1.000000){
        if(angle > 180){
          dir = -2;

        }
        if(angle < 0){
          dir = 2;

        }
        angle += dir;

      }
      servo_2.write(angle);
      _delay(0.02);

      _loop();
  }

}

void _loop() {
}

void loop() {
  _loop();
}