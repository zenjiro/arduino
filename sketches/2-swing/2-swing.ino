// This was generated by Best_codes for Arduino Cat by Osoyoo
// Codes benefit others

#include <Arduino.h>
#include <IRremote.hpp>
#include <Wire.h>
#include <SoftwareSerial.h>
#include <Servo.h>

float running = 0;
float angle = 0;
float dir = 0;

int getKey() {
  if (!IrReceiver.decode()) return -1;

  const bool isRepeat = IrReceiver.decodedIRData.flags & IRDATA_FLAGS_IS_REPEAT;
  const uint16_t command = IrReceiver.decodedIRData.command;
  IrReceiver.resume();
  if (isRepeat) return -1;

  switch (command) {
    case 0x1C: return 'O';
    case 0x16: return '*';
    case 0x0D: return '#';
    case 0x18: return 'U';
    case 0x52: return 'D';
    case 0x08: return 'L';
    case 0x5A: return 'R';
    case 0x45: return 1;
    case 0x46: return 2;
    case 0x47: return 3;
    case 0x44: return 4;
    case 0x40: return 5;
    case 0x43: return 6;
    case 0x07: return 7;
    case 0x15: return 8;
    case 0x09: return 9;
    case 0x19: return 0;
    default: return -1;
  }
}
Servo servo_2;

void _delay(float seconds) {
  long endTime = millis() + seconds * 1000;
  while(millis() < endTime) _loop();
}

void setup() {
  IrReceiver.begin(7, DISABLE_LED_FEEDBACK);
  servo_2.attach(2);
  running = 0;
  angle = 90;
  dir = 2;
  while(1) {
      const int key = getKey();
      if(key == 1){
        angle = 0;

      }
      if(key == 2){
        angle = 90;

      }
      if(key == 3){
        angle = 180;

      }
      if(key == 'O'){
        running = ((1 - running));

      }
      if(running == 1.000000){
        if(angle > 180){
          dir = -2;

        }
        if(angle < 0){
          dir = 2;

        }
        angle += dir;

      }
      servo_2.write(angle);
      _delay(0.02);

      _loop();
  }

}

void _loop() {
}

void loop() {
  _loop();
}
