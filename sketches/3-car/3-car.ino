// generated by mBlock5 for <your product>
// codes make you happy

#include <Arduino.h>
#include <IRremote.hpp>
#include <Wire.h>
#include <SoftwareSerial.h>
#include <Servo.h>

float ultrasonic_sensor = 0;
float running = 0;
float speed = 0;
float ir_sensor = 0;
float angle = 0;
float max_speed = 0;

Servo servo_2;
float getDistance(int trig,int echo){
    pinMode(trig,OUTPUT);
    digitalWrite(trig,LOW);
    delayMicroseconds(2);
    digitalWrite(trig,HIGH);
    delayMicroseconds(10);
    digitalWrite(trig,LOW);
    pinMode(echo, INPUT);
    return pulseIn(echo,HIGH,30000)/58.0;
}
int getKey() {
  if (!IrReceiver.decode()) return -1;

  const bool isRepeat = IrReceiver.decodedIRData.flags & IRDATA_FLAGS_IS_REPEAT;
  const uint16_t command = IrReceiver.decodedIRData.command;
  IrReceiver.resume();
  if (isRepeat && command != 0x18 && command != 0x52 &&
      command != 0x08 && command != 0x5A) return -1;

  switch (command) {
    case 0x1C: return 'O';
    case 0x16: return '*';
    case 0x0D: return '#';
    case 0x18: return 'U';
    case 0x52: return 'D';
    case 0x08: return 'L';
    case 0x5A: return 'R';
    case 0x45: return 1;
    case 0x46: return 2;
    case 0x47: return 3;
    case 0x44: return 4;
    case 0x40: return 5;
    case 0x43: return 6;
    case 0x07: return 7;
    case 0x15: return 8;
    case 0x09: return 9;
    case 0x19: return 0;
    default: return -1;
  }
}

void _delay(float seconds) {
  long endTime = millis() + seconds * 1000;
  while(millis() < endTime) _loop();
}

void setup() {
  pinMode(12,OUTPUT);
  pinMode(11,OUTPUT);
  servo_2.attach(2);
  IrReceiver.begin(10, DISABLE_LED_FEEDBACK);
  pinMode(4,INPUT);
  pinMode(5,OUTPUT);
  running = 0;
  speed = 0;
  max_speed = 255;
  angle = 90;
  digitalWrite(12,1);
  digitalWrite(11,0);
  servo_2.write(90);
  while(1) {
      ultrasonic_sensor = getDistance(7,8);
      ir_sensor = getKey();
      if((!digitalRead(4))  ||  (ir_sensor == toascii(String("O")[0]))){
        running = ((1 - running));
        max_speed = 255;
        _delay(0.3);

      }
      if(ir_sensor == 0.000000){
        running = 0;

      }
      if(ir_sensor == 1.000000){
        running = 1;
        max_speed = 96;

      }
      if(ir_sensor == 2.000000){
        running = 1;
        max_speed = 192;

      }
      if(ir_sensor == 3.000000){
        running = 1;
        max_speed = 255;

      }
      if(ir_sensor == toascii(String("U")[0])){
        max_speed = constrain((max_speed + 16), 64, 255);

      }
      if(ir_sensor == toascii(String("D")[0])){
        max_speed = constrain((max_speed - 16), 64, 255);

      }
      if(ultrasonic_sensor < 20){
        speed = map(constrain(ultrasonic_sensor, 5, 20), 5, 20, 0, max_speed);

      }else{
        speed = max_speed;

      }
      if(ir_sensor == toascii(String("L")[0])){
        angle = constrain((angle - 15), 0, 180);

      }
      if(ir_sensor == toascii(String("R")[0])){
        angle = constrain((angle + 15), 0, 180);

      }
      if(ir_sensor == 4.000000){
        angle = 0;

      }
      if(ir_sensor == 5.000000){
        angle = 90;

      }
      if(ir_sensor == 6.000000){
        angle = 180;

      }
      if(running == 1.000000){
        analogWrite(5,speed);
        servo_2.write(angle);

      }else{
        analogWrite(5,0);
        servo_2.write(90);

      }
      _delay(0.1);

      _loop();
  }

}

void _loop() {
}

void loop() {
  _loop();
}
