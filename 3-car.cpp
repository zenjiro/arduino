// generated by mBlock5 for <your product>
// codes make you happy

#include "IRremoteExt.h"

#include <Arduino.h>
#include <Wire.h>
#include <SoftwareSerial.h>
#include <Servo.h>

float ultrasonic_sensor = 0;
float running = 0;
float speed = 0;
float ir_sensor = 0;
float angle = 0;
float max_speed = 0;

Servo servo_2;
float getDistance(int trig,int echo){
    pinMode(trig,OUTPUT);
    digitalWrite(trig,LOW);
    delayMicroseconds(2);
    digitalWrite(trig,HIGH);
    delayMicroseconds(10);
    digitalWrite(trig,LOW);
    pinMode(echo, INPUT);
    return pulseIn(echo,HIGH,30000)/58.0;
}
int getKey(){
   handleIRremote();
    unsigned long value = getPressedIRremote();
    if( value != 0xffffffff){

     //Serial.println(value,HEX);
      if (value==0xff38c7) return 'O';
      else if (value==0xff6897) return '*';
      else if (value==0xffb04f) return '#';
      else if (value==0xff18e7) return 'U';
      else if (value==0xff4ab5) return 'D';
      else if (value==0xff10ef) return 'L';
      else if (value==0xff5aa5) return 'R';
      else if (value==0xffa25d) return 1;
      else if (value==0xff629D) return 2;
      else if (value==0xffe21d) return 3;
      else if (value==0xff22dd) return 4;
      else if (value==0xff02fd) return 5;
      else if (value==0xffc23d) return 6;
      else if (value==0xffe01f) return 7;
      else if (value==0xffa857) return 8;
      else if (value==0xff906f) return 9;
      else if (value==0xff9867) return 0;
    }
    return -1;

}

void _delay(float seconds) {
  long endTime = millis() + seconds * 1000;
  while(millis() < endTime) _loop();
}

void setup() {
  pinMode(12,OUTPUT);
  pinMode(11,OUTPUT);
  servo_2.attach(2);
  beginIRremote(10);
  pinMode(4,INPUT);
  pinMode(5,OUTPUT);
  running = 0;
  speed = 0;
  max_speed = 255;
  angle = 90;
  digitalWrite(12,1);
  digitalWrite(11,0);
  servo_2.write(90);
  while(1) {
      ultrasonic_sensor = getDistance(7,8);
      ir_sensor = getKey();
      if((!digitalRead(4))  ||  (ir_sensor == toascii(String("O")[0]))){
        running = ((1 - running));
        max_speed = 255;
        _delay(0.3);

      }
      if(ir_sensor == 0.000000){
        running = 0;

      }
      if(ir_sensor == 1.000000){
        running = 1;
        max_speed = 96;

      }
      if(ir_sensor == 2.000000){
        running = 1;
        max_speed = 192;

      }
      if(ir_sensor == 3.000000){
        running = 1;
        max_speed = 255;

      }
      if(ir_sensor == toascii(String("U")[0])){
        max_speed = constrain((max_speed + 16), 64, 255);

      }
      if(ir_sensor == toascii(String("D")[0])){
        max_speed = constrain((max_speed - 16), 64, 255);

      }
      if(ultrasonic_sensor < 20){
        speed = map(constrain(ultrasonic_sensor, 5, 20), 5, 20, 0, max_speed);

      }else{
        speed = max_speed;

      }
      if(ir_sensor == toascii(String("L")[0])){
        angle = constrain((angle - 15), 0, 180);

      }
      if(ir_sensor == toascii(String("R")[0])){
        angle = constrain((angle + 15), 0, 180);

      }
      if(ir_sensor == 4.000000){
        angle = 0;

      }
      if(ir_sensor == 5.000000){
        angle = 90;

      }
      if(ir_sensor == 6.000000){
        angle = 180;

      }
      if(running == 1.000000){
        analogWrite(5,speed);
        servo_2.write(angle);

      }else{
        analogWrite(5,0);
        servo_2.write(90);

      }
      _delay(0.1);

      _loop();
  }

}

void _loop() {
}

void loop() {
  _loop();
}